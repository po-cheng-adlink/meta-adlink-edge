## conf/layer.conf
```bitbake
# We have a conf and classes directory, add to BBPATH
BBPATH .= ":${LAYERDIR}"

# We have a packages directory, add to BBFILES
BBFILES += "${LAYERDIR}/recipes-*/*/*.bb \
            ${LAYERDIR}/recipes-*/*/*.bbappend"

BBFILE_COLLECTIONS += "adlink-edge"

BBFILE_PATTERN_adlink-edge := "^${LAYERDIR}"
BBFILE_PRIORITY_adlink-edge = "11"
LAYERVERSION_adlink-edge = "4"
LAYERSERIES_COMPAT_adlink-edge = "kirkstone mickledore scarthgap"
```
